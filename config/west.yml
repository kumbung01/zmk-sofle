## config/west.yml
```yaml
manifest:
  remotes:
    - name: zmkfirmware
      url-base: https://github.com/zmkfirmware
      # Additional modules containing boards/shields/custom code can be listed here as well.
      # See:
      # - https://zmk.dev/docs/features/modules
      # - https://docs.zephyrproject.org/3.5.0/develop/west/manifest.html#projects
    - name: gpeye
      url-base: https://github.com/GPeye
    - name: badjeff
      url-base: https://github.com/badjeff
    - name: nrfconnect
      url-base: https://github.com/nrfconnect
  projects:
    - name: mario-peripheral-animation
      remote: gpeye
      revision: main 
    - name: zmk
      remote: zmkfirmware
      revision: main
      import: app/west.yml
    - name: zmk-feature-split-esb
      remote: badjeff
      revision: main  
    - name: sdk-nrf
      remote: nrfconnect
      revision: v2.6.4 # zephyr v3.5.99
      path: nrf
    - name: nrfxlib
      remote: nrfconnect
      revision: v2.6.4
      repo-path: sdk-nrfxlib
      path: nrfxlib
  self:
    path: config
```
